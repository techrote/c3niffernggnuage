## firmware/c3/main/Kconfig.projbuild
```kconfig
menu "C3niffer NGGUNAGE"

choice NGN_NODE_ROLE
    prompt "Logical node role"
    default NGN_NODE_ROLE_UNCONFIGURED
    help
        Select the logical A/B/C identity explicitly. The unconfigured default is
        intentionally safe so flashing order can never assign identity implicitly.

config NGN_NODE_ROLE_UNCONFIGURED
    bool "Unconfigured"

config NGN_NODE_ROLE_A
    bool "Node A"

config NGN_NODE_ROLE_B
    bool "Node B"

config NGN_NODE_ROLE_C
    bool "Node C / coordinator"

endchoice

config NGN_BOARD_PROFILE
    string "Board profile identifier"
    default "generic-esp32c3"
    help
        Human-readable board profile name. NGN-001 deliberately defines no OLED,
        button, battery or other board-specific pins. Later issues may introduce
        verified profiles behind this seam.

menu "Three-node radio schedule"

config NGN_RADIO_CHANNEL
    int "Fixed Wi-Fi channel (same on A/B/C)"
    range 1 11
    default 6

config NGN_RADIO_BURST_COUNT
    int "Probes in each A/B/C slot"
    range 1 16
    default 4

config NGN_RADIO_PROBE_SPACING_MS
    int "Probe spacing in milliseconds"
    range 1 65535
    default 10

config NGN_RADIO_SYNC_SLOT_MS
    int "Coordinator SYNC slot in milliseconds"
    range 1 65535
    default 40

config NGN_RADIO_PROBE_SLOT_MS
    int "Each node's probe slot in milliseconds"
    range 1 65535
    default 80

config NGN_RADIO_COEXIST_MS
    int "Reserved coexistence opportunity in milliseconds (no scanning)"
    range 0 65535
    default 80
    help
        An opportunity placeholder only. NGN-002 never starts BLE scanning.

config NGN_RADIO_HEALTH_SLOT_MS
    int "Each node's staggered health slot in milliseconds"
    range 1 65535
    default 10

config NGN_RADIO_MISSING_EPOCHS
    int "Missing-node and coordinator timeout in epochs"
    range 1 32
    default 4

config NGN_RADIO_RX_QUEUE_DEPTH
    int "ESP-NOW receive queue records"
    range 1 64
    default 16

config NGN_RADIO_TX_QUEUE_DEPTH
    int "ESP-NOW transmit queue records"
    range 1 64
    default 16

config NGN_RADIO_STATUS_QUEUE_DEPTH
    int "ESP-NOW completion queue records"
    range 1 64
    default 16

endmenu

menu "Wi-Fi CSI acquisition"

config NGN_CSI_RAW_QUEUE_DEPTH
    int "Raw CSI callback queue records"
    range 1 32
    default 8
    help
        Fixed queue between the ESP-IDF CSI callback and the CSI worker.
        A full queue drops the newest known-source CSI record and increments
        an explicit diagnostic counter.

config NGN_CSI_PACKET_QUEUE_DEPTH
    int "Decoded CSI output queue records"
    range 1 16
    default 4
    help
        Fixed queue containing normalized CSI packet records for later
        signal processing or the current diagnostic drain.

config NGN_CSI_ATTRIBUTION_WINDOW_MS
    int "Accepted-probe correlation window in milliseconds"
    range 1 50
    default 5
    help
        Match CSI callback capture time to the nearest accepted PROBE from
        the same logical source inside this window. The selected delta is
        retained in every attributed record and must be validated on hardware.

config NGN_CSI_DIAGNOSTIC_RAW
    bool "Emit per-packet raw CSI records to the local console"
    default n
    help
        DEVELOPMENT ONLY. When enabled, a low-priority consumer prints each
        bounded known-source CSI record including raw I/Q bytes. This can
        generate heavy serial traffic and is disabled by default.

endmenu

menu "Passive BLE observation"

config NGN_BLE_QUEUE_DEPTH
    int "Normalized BLE scan-report queue depth"
    range 4 64
    default 16
    help
        Fixed queue between the NimBLE GAP callback and the BLE worker. A full
        queue drops the newest report and increments a diagnostic counter.

config NGN_BLE_WORKER_STACK_SIZE
    int "BLE worker stack size"
    range 2048 8192
    default 4096

config NGN_BLE_DIAGNOSTIC_RAW_ADDRESS
    bool "Expose raw BLE addresses in transient debug logging"
    default n
    help
        PRIVACY WARNING: enabling this emits current over-the-air BLE addresses
        to the local debug console. It is disabled by default and raw addresses
        are never present in the normal track-event sink contract.

endmenu

endmenu
```
